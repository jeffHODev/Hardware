/******************** (C) COPYRIGHT 2014 盛元电子工作室 **************************
 * 文件名  ：delay.c
 * 描    述：MODBUS开发
 * 实验平台：STM32手持机开发板
 * 硬件连接：无
 * 库版本  ：ST3.0.0
 * 作者    ：小奕
 * 项目说明：MODBUS
**********************************************************************************/
#include "delay.h" 
#include "usart1.h"
#include "driveboard.h"
#include "system.h"

uint8_t Second_Flage=0;
uint8_t Msecond_Flage=0;
uint8_t Msad_Flage=0;
/***********************************************************************************
 * 函数名：delay_System_MS
 * 描述  ：System_MS延时
 * 输入  ：无
 * 输出  ：无
************************************************************************************/
void delay_ms(__IO uint32_t nCount)
{
	uint32_t i,j;
	for(i=0;i<nCount;i++)
  	for(j=0;j<12000;j++);
}
/***********************************************************************************
 * 函数名：delay_us
 * 描述  ：us延时
 * 输入  ：无
 * 输出  ：无
************************************************************************************/
void delay_us(__IO uint32_t nCount)
{
	uint32_t i,j;
	for(i=0;i<nCount;i++)
	{
  	for(j=0;j<10;j++)
		{
			__ASM("NOP");
		}	
	}
}


/***********************************************************************************
 * 函数名：SysTick_Init
 * 输  入: 无
 * 输  出: 无
 * 功  能：启动系统滴答定时器 SysTick0 10ms进入一次
************************************************************************************/
void SysTick_Init(void)
{
	if (SysTick_Config(72*1000))
  { 
    /* Capture error */ 
    while (1);
  }
}



/***********************************************************************************
 * 函数名：SysTick_ISR
 * 输  入:
 * 输  出:
 * 功能说明：SysTick中断服务程序，每隔10MS进入1次
************************************************************************************/
void SysTick_ISR(void)
{
	static uint16_t System_MS=1;								// 计时时间	毫秒

	// 时钟函数																
	if(System_MS++>=1000)												// 计满1S钟
	{																						// 
		System_MS=0;															// 毫秒计数清零
		Second_Flage=1;
	}
	// 每50ms更新
	if(System_MS%50==0)
	{
		Msecond_Flage=1;
	}
	// 
	Msad_Flage=1;
}



/******************** (C) COPYRIGHT 2013 盛元电子工作室 **************************/
